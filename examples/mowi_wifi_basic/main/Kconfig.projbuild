## examples/mowi_wifi_basic/main/Kconfig.projbuild
```kconfig
menu "Mowi WiFi Basic Configuration"

    config MOWI_WIFI_SSID 
        string "SSID of targeted Acces Point"
        default "mowi_wifi_accpoint"

    config MOWI_WIFI_PSWD 
        string "Password of targeted Acces Point"
        default "mowi_rocks"

    config MOWI_FLOW_CONTROL_QUEUE_TIMEOUT_MS 
        int "Flow Control Quete Timeout [ms]"
        default 100

    config MOWI_FLOW_CONTROL_QUEUE_LENGTH
        int "Flow Control Queue Lenght"
        default 40

    config MOWI_FLOW_CONTROL_WIFI_SEND_TIMEOUT_MS
        int "Flow Comtrol WiFi Send Timeout [ms]"
        default 100

    config MOWI_MOSAIC_UART_PORT_NUM
        int "ESP x Mosaic UART Port Number of ESP"
        default 1

    config MOWI_MOSAIC_UART_BUF_SIZE
        int "ESP x Mosaic UART Buffer Size"
        default 1024

endmenu
```

## examples/mowi_wifi_basic/sdkconfig.defaults
```kconfig
#
# Certificate Bundle
#
CONFIG_MBEDTLS_CERTIFICATE_BUNDLE=n
CONFIG_MBEDTLS_CERTIFICATE_BUNDLE_DEFAULT_FULL=n

#
# ESP NETIF Adapter
#
CONFIG_ESP_NETIF_TCPIP_ADAPTER_COMPATIBLE_LAYER=n

#
# Ethernet
#
CONFIG_ETH_ENABLED=y
CONFIG_ETH_USE_ESP32_EMAC=y
CONFIG_ETH_PHY_INTERFACE_RMII=y
CONFIG_ETH_RMII_CLK_OUTPUT=y
CONFIG_ETH_RMII_CLK_OUTPUT_GPIO0=y

#
# MOWI WiFi Client Configuration
#
CONFIG_MOWI_WIFI_SSID="mowi_wifi_accpoint"
CONFIG_MOWI_WIFI_PSWD="mowi_rocks"
CONFIG_MOWI_FLOW_CONTROL_QUEUE_TIMEOUT_MS=100
CONFIG_MOWI_FLOW_CONTROL_QUEUE_LENGTH=40
CONFIG_MOWI_FLOW_CONTROL_WIFI_SEND_TIMEOUT_MS=100
```

## examples/mowi_wifi_client/main/Kconfig.projbuild
```kconfig
menu "Mowi WiFi Client Configuration"

    config MOWI_FLOW_CONTROL_QUEUE_TIMEOUT_MS 
        int "Flow Control Quete Timeout [ms]"
        default 100

    config MOWI_FLOW_CONTROL_QUEUE_LENGTH
        int "Flow Control Queue Lenght"
        default 40

    config MOWI_FLOW_CONTROL_WIFI_SEND_TIMEOUT_MS
        int "Flow Comtrol WiFi Send Timeout [ms]"
        default 100

    config MOWI_MOSAIC_UART_PORT_NUM
        int "ESP x Mosaic UART Port Number of ESP"
        default 1

    config MOWI_MOSAIC_UART_BUF_SIZE
        int "ESP x Mosaic UART Buffer Size"
        default 1024

    config  MOWI_PROV_MGR_REMEMBER
        bool "Remember previous state and skip provisioning"
        default y

endmenu
```

## examples/mowi_wifi_client/sdkconfig.defaults
```kconfig
#
# Certificate Bundle
#
CONFIG_MBEDTLS_CERTIFICATE_BUNDLE=n
CONFIG_MBEDTLS_CERTIFICATE_BUNDLE_DEFAULT_FULL=n

#
# ESP NETIF Adapter
#
CONFIG_ESP_NETIF_TCPIP_ADAPTER_COMPATIBLE_LAYER=n

#
# Ethernet
#
CONFIG_ETH_ENABLED=y
CONFIG_ETH_USE_ESP32_EMAC=y
CONFIG_ETH_PHY_INTERFACE_RMII=y
CONFIG_ETH_RMII_CLK_OUTPUT=y
CONFIG_ETH_RMII_CLK_OUTPUT_GPIO0=y

#
# Enable BT stack
#
CONFIG_BT_ENABLED=y
CONFIG_BTDM_CTRL_MODE_BLE_ONLY=y
CONFIG_BTDM_CTRL_MODE_BR_EDR_ONLY=n
CONFIG_BTDM_CTRL_MODE_BTDM=n
CONFIG_BT_NIMBLE_ENABLED=y

#
# In Bluedroid binary is larger than default
#
CONFIG_PARTITION_TABLE_CUSTOM=y
CONFIG_PARTITION_TABLE_CUSTOM_FILENAME="partitions.csv"
CONFIG_PARTITION_TABLE_FILENAME="partitions.csv"
```
